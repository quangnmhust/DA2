## New folder/hello_world/main/Kconfig.projbuild
```kconfig
menu "WiFi Config Menu"

    config SSID
        string  "SSID"
        default "Tom Bi"
        help
            SSID.

    config PASSWORD
        string  "PASSWORD"
        default  "TBH123456"
        help 
            PASSWORD.

    config MAXIMUM_AP
        int "Maximum access points"
        default  10
        help 
            Maximum access points.

    config MAXIMUM_RETRY
        int "Maximum retry"
        default 25
        help
            Set the Maximum retry to avoid station reconnecting to the AP unlimited when the AP is really inexistent.

    config SHOW_LIST_ACCESS_POINTS_FOUND
        bool "Show list Access Points found."
        default y
        help
            Show list Access Points found.

endmenu

menu "MQTT Config menu"

    config BROKER_URI
        string "Broker URL"
        default "mqtt://sanslab.viewdns.net:1883"
        help
            URL of an mqtt broker which this device connects to.

    config BROKER_HOST
        string "Broker host"
        default "sanslab.viewdns.net"
        help 
            Host is MQTT server domain <ipv4 as string>

    config BROKER_PORT
        int "Broker port"
        default 1883
        help 
            Port is MQTT server port

    config MQTT_USERNAME
        string "User name"
        default "admin"
        help 
            MQTT username

    config MQTT_PASSWORD
        string  "Password"
        default  "123"
        help 
            MQTT password
    
    config MQTT_TOPIC
        string  "Topic"
        default  "modelParam"
        help 
            MQTT topic

    config BROKER_CERTIFICATE_OVERRIDE
        string "Broker certificate override"
        default ""
        help
            Please leave empty if broker certificate included from a textfile; otherwise fill in a base64 part of PEM
            format certificate

    config BROKER_CERTIFICATE_OVERRIDDEN
        bool
        default y if BROKER_CERTIFICATE_OVERRIDE != ""

    config BROKER_BIN_SIZE_TO_SEND
        # This option is not visible and is used only to set parameters for example tests
        # Here we configure the data size to send and to be expected in the python script
        int
        default 20000

endmenu
menu "SHT configuration"
    choice SHT
        prompt "Choose sht"
        default USING_SHT41
        help
            Choose how to masure values from the sensor. See the main.c for
            details.

        config USING_SHT41
            bool "SHT41"
            help
                In this example it uses the high level function
                sht3x_measure() to perform one measurement in each cycle.

        config USING_SHT31
            bool "SHT31"
            help
                In this example it starts the measurement, waits for the
                results and fetches the results using separate functions

    endchoice
endmenu

menu "SD SPI Example Configuration"

    config EXAMPLE_FORMAT_IF_MOUNT_FAILED
        bool "Format the card if mount failed"
        default n
        help
            If this config item is set, format_if_mount_failed will be set to true and the card will be formatted if
            the mount has failed.

    config EXAMPLE_PIN_MOSI
        int "MOSI GPIO number"
        default 15 if IDF_TARGET_ESP32
        default 35 if IDF_TARGET_ESP32S2
        default 35 if IDF_TARGET_ESP32S3
        default 4  # C3 and others

    config EXAMPLE_PIN_MISO
        int "MISO GPIO number"
        default 2 if IDF_TARGET_ESP32
        default 37 if IDF_TARGET_ESP32S2
        default 37 if IDF_TARGET_ESP32S3
        default 6  # C3 and others

    config EXAMPLE_PIN_CLK
        int "CLK GPIO number"
        default 14 if IDF_TARGET_ESP32
        default 36 if IDF_TARGET_ESP32S2
        default 36 if IDF_TARGET_ESP32S3
        default 5  # C3 and others

    config EXAMPLE_PIN_CS
        int "CS GPIO number"
        default 13 if IDF_TARGET_ESP32
        default 34 if IDF_TARGET_ESP32S2
        default 34 if IDF_TARGET_ESP32S3
        default 1  # C3 and others

endmenu
```
